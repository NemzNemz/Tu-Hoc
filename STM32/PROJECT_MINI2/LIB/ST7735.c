#include "ST7735.h"

extern SPI_HandleTypeDef hspi1;

#define LCD_PORT GPIOB
#define CS_LCD_Pin GPIO_PIN_0
#define A0_LCD_Pin GPIO_PIN_1
#define RST_LCD_Pin GPIO_PIN_2

//---------------------------------------------------- DATA ST7735 --------------------------------------------------------------//
//Frame rate control 1-2-3 data
const uint8_t FRC_data1[] = {0x01, 0x2C, 0x2D};
const uint8_t FRC_data2[] = {0x01, 0x2C, 0x2D};
const uint8_t FRC_data3[] = {0x01, 0x2C, 0x2D, 0x01, 0x2C, 0x2D};

//Display inversion control data
const uint8_t DI_data1[] = {0x07};

//Power control 1-2-3-4-5 data
const uint8_t PWC_data1[] = {0xA2, 0x02, 0x84};
const uint8_t PWC_data2[] = {0xC5};
const uint8_t PWC_data3[] = {0x0A, 0x00};
const uint8_t PWC_data4[] = {0x8A, 0x2A};
const uint8_t PWC_data5[] = {0x8A, 0xEE};

//VCOM Control Data
const uint8_t VMC_data1[] = {0x0E};

//Gamma adjustment +/- data
const uint8_t GM_data1[] = {0x02, 0x1C, 0x07, 0x12, 0x37, 0x32, 0x29, 0x2D, 0x29, 0x25, 0x2B, 0x39, 0x00, 0x01, 0x03, 0x10};
const uint8_t GM_data2[] = {0x03, 0x1D, 0x07, 0x06, 0x2E, 0x2C, 0x29, 0x2D, 0x2E, 0x2E, 0x37, 0x3F, 0x00, 0x00, 0x02, 0x10};

//Memory data access control data - RGB
const uint8_t MDA_data1[] = {0x00};

//Interface pixel format data 5-6-5 RGB
const uint8_t INTPXF_data[] = {0x05};


//Struct ST7735, bao gom CMD, DATA va so luong tham so
LCD_FUNC_CMD lcd_func[] = {
	{FRMCTR1, FRC_data1, sizeof(FRC_data1)},      	//Lenh set frame1    [0]
	{FRMCTR2, FRC_data2, sizeof(FRC_data2)},      	//Lenh set frame2    [1]
	{FRMCTR3, FRC_data3, sizeof(FRC_data3)},      	//Lenh set frame3    [2]
	{INVCTR, DI_data1, sizeof(DI_data1)},         	//Lenh inversion     [3]
	{PWCTR1, PWC_data1, sizeof(PWC_data1)},         //Lenh power1        [4]
	{PWCTR2, PWC_data2, sizeof(PWC_data2)},		      //Lenh power2        [5]
	{PWCTR3, PWC_data3, sizeof(PWC_data3)},         //Lenh power3        [6]
	{PWCTR4, PWC_data4, sizeof(PWC_data4)},         //Lenh power4        [7]
	{PWCTR5, PWC_data5, sizeof(PWC_data5)},         //Lenh power5        [8] 
	{VMCTR1, VMC_data1, sizeof(VMC_data1)},         //Lenh VCOM          [9]
	{GMCTRP1, GM_data1, sizeof(GM_data1)},   				//Lenh Gamma+        [10]
	{GMCTRN1, GM_data2, sizeof(GM_data2)},   				//Lenh Gamma-     	 [11]
	{MADCTL, MDA_data1, sizeof(MDA_data1)},         //Lenh Memory Access [12]
	{INTPXF, INTPXF_data, sizeof(INTPXF_data)},     //Lenh RGB           [13]
};

const uint16_t Font7x10 [] = { //const de ep luu vao Flash, ko luu RAM 20KB, bi tran
0x0000, 0x0000, 0x0000, 0x0000, 0x0000, 0x0000, 0x0000, 0x0000, 0x0000, 0x0000,  // sp
0x1000, 0x1000, 0x1000, 0x1000, 0x1000, 0x1000, 0x0000, 0x1000, 0x0000, 0x0000,  // !
0x2800, 0x2800, 0x2800, 0x0000, 0x0000, 0x0000, 0x0000, 0x0000, 0x0000, 0x0000,  // "
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0x0000, 0x0000, 0x0000, 0x7400, 0x4C00, 0x0000, 0x0000, 0x0000, 0x0000, 0x0000,  // ~
};
FONT font_7x10 = {10, 7, Font7x10};


//------------------------------------------LCD FUNC-------------------------------------------//
void SPI_WRITE(uint8_t data){
	//Keo CS xuong 0
	HAL_GPIO_WritePin(LCD_PORT, CS_LCD_Pin, 0);
	//Truyen data SPI
	HAL_SPI_Transmit(&hspi1, &data, 1, 1000);
	//Keo CS len 1
	HAL_GPIO_WritePin(LCD_PORT, CS_LCD_Pin, 1);
}

void LCD_Write_CMD(uint8_t cmd){ 
	//Keo CS xuong 0 
	HAL_GPIO_WritePin(LCD_PORT, CS_LCD_Pin, 0);
	//Keo A0 ST7735 (PB1) xuong 0 de gui CMD 
	HAL_GPIO_WritePin(LCD_PORT, A0_LCD_Pin, 0); 
	HAL_SPI_Transmit(&hspi1, &cmd, 1, 1000); 
	//Keo CS len 1 
	 HAL_GPIO_WritePin(LCD_PORT, CS_LCD_Pin, 1); 
}

void LCD_Write_Data(uint8_t data){ 
	//Keo CS xuong 0 
	HAL_GPIO_WritePin(LCD_PORT, CS_LCD_Pin, 0);
	//Keo A0 ST7735 len 1 de gui DATA 
	HAL_GPIO_WritePin(LCD_PORT, A0_LCD_Pin, 1); 
	HAL_SPI_Transmit(&hspi1, &data, 1, 1000); 
	//Keo CS len 1 
	HAL_GPIO_WritePin(LCD_PORT, CS_LCD_Pin, 1);
}

void LCD_set_pos(uint8_t xs, uint8_t xe, uint8_t ys, uint8_t ye){
	//Lenh set hang
  LCD_Write_CMD(0x2A);
	//Di tu 0 den x_start
  LCD_Write_Data(0x00);
  LCD_Write_Data(xs);
	//Di tu 0 den x_end
  LCD_Write_Data(0x00);
  LCD_Write_Data(xe);

	//Lenh set cot
  LCD_Write_CMD(0x2B);
	//Di tu 0 den y_start
  LCD_Write_Data(0x00);
  LCD_Write_Data(ys);
	//Di tu 0 den y_end
  LCD_Write_Data(0x00);
  LCD_Write_Data(ye);
}


void LCD_fill_color(uint16_t color){
	//Lenh ghi bo nho trong
  LCD_Write_CMD(0x2C);
	//To mau 
  for (uint32_t i = 0; i < 128*160; i++){
		LCD_Write_Data(color >> 8);
    LCD_Write_Data(color & 0xFF);
  }
}

void LCD_Init(){
	//Reset timing: tRESW >5us
	HAL_GPIO_WritePin(GPIOA, RST_LCD_Pin, 0);
	HAL_Delay(10);
	//Reset timing: tREST <120ms
	HAL_GPIO_WritePin(GPIOA, RST_LCD_Pin, 1);
	HAL_Delay(10);
	//Software Reset
	LCD_Write_CMD(0x01);
	//Delay SWRST
	HAL_Delay(120);
	//Sleep Out - Boost on
	LCD_Write_CMD(0x11);
	//Delay SLEEP OUT
	HAL_Delay(120);
	
	//Frame Rate Control 1
	LCD_Write_CMD(lcd_func[0].cmd);
	for(uint8_t i =0; i < lcd_func[0].lenght; i ++){
		LCD_Write_Data(lcd_func[0].data[i]);
	}
	//Frame Rate Control 2
	LCD_Write_CMD(lcd_func[1].cmd);
	for(uint8_t i = 0; i < lcd_func[1].lenght; i++){
		LCD_Write_Data(lcd_func[1].data[i]);
	}
	//Frame Rate Control 3
	LCD_Write_CMD(lcd_func[2].cmd);
	for(uint8_t i = 0; i < lcd_func[2].lenght; i++){
		LCD_Write_Data(lcd_func[2].data[i]);
	}
	//Display Inversion control
	LCD_Write_CMD(lcd_func[3].cmd);
	for(uint8_t i = 0; i < lcd_func[3].lenght; i++){
		LCD_Write_Data(lcd_func[3].data[i]);
	}
	//Power Control 1
	LCD_Write_CMD(lcd_func[4].cmd);
	for(uint8_t i = 0; i < lcd_func[4].lenght; i++){
		LCD_Write_Data(lcd_func[4].data[i]);
	}
	//Power Control 2
	LCD_Write_CMD(lcd_func[5].cmd);
	for(uint8_t i = 0; i < lcd_func[5].lenght; i++){
		LCD_Write_Data(lcd_func[5].data[i]);
	}
	//Power Control 3
	LCD_Write_CMD(lcd_func[6].cmd);
	for(uint8_t i = 0; i < lcd_func[6].lenght; i++){
		LCD_Write_Data(lcd_func[6].data[i]);
	}
	//Power Control 4
	LCD_Write_CMD(lcd_func[7].cmd);
	for(uint8_t i = 0; i < lcd_func[7].lenght; i++){
		LCD_Write_Data(lcd_func[7].data[i]);
	}
	//Power Control 5
	LCD_Write_CMD(lcd_func[8].cmd);
	for(uint8_t i = 0; i < lcd_func[8].lenght; i++){
		LCD_Write_Data(lcd_func[8].data[i]);
	}
	//VCOM Control 1
	LCD_Write_CMD(lcd_func[9].cmd);
	for(uint8_t i = 0; i < lcd_func[9].lenght; i++){
		LCD_Write_Data(lcd_func[9].data[i]);
	};
	//Gamma adjustment +
	LCD_Write_CMD(lcd_func[10].cmd);
	for(uint8_t i = 0; i < lcd_func[10].lenght; i++){
		LCD_Write_Data(lcd_func[10].data[i]);
	}
	//Gamma adjustment -
	LCD_Write_CMD(lcd_func[11].cmd);
	for(uint8_t i = 0; i < lcd_func[11].lenght; i++){
		LCD_Write_Data(lcd_func[11].data[i]);
	}
	//Memory Data Access Control
	LCD_Write_CMD(lcd_func[12].cmd);
	for(uint8_t i = 0; i < lcd_func[12].lenght; i++){
		LCD_Write_Data(lcd_func[12].data[i]);
	}
	//Interface pixel format
	LCD_Write_CMD(lcd_func[13].cmd);
	for(uint8_t i = 0; i < lcd_func[13].lenght; i++){
		LCD_Write_Data(lcd_func[13].data[i]);
	}
	
	//Display Inversion off
	LCD_Write_CMD(0x20);
	//Set vi tri va do phan giai cho LCD
	LCD_set_pos(0, 128, 0, 160);
	//Display On
	LCD_Write_CMD(0x29);
	HAL_Delay(120);
}

void LCD_Draw_Pixel(uint8_t x, uint8_t y, uint16_t color){
	//Neu nhu chieu ngang lon hon 128 va chieu dai lon hon 160, thoat
	if(x >= 128 || y >= 160){
		return ;
	}
	LCD_set_pos(x, x+1, y, y+1);
	//Memory Write
	LCD_Write_CMD(0x2C);
	//Ve 1 pixel mau
	LCD_Write_Data(color >> 8);
	LCD_Write_Data(color & 0xFF);
}

void LCD_draw_char(uint8_t x, uint8_t y, char character, FONT font, uint16_t color, uint16_t bg){
		uint16_t i, j;
    uint16_t pixel_data;
    LCD_set_pos(x, x + font.width - 1,
                y, y + font.height - 1);

    LCD_Write_CMD(0x2C);
    for(i = 0; i < font.height; i++) {
    pixel_data = font.data[(character - 32) * font.height + i];

    for(j = 0; j < font.width; j++) {
        if ((pixel_data << j) & 0x8000) {
            LCD_Write_Data(color >> 8);
            LCD_Write_Data(color & 0xFF);
        } else {
            LCD_Write_Data(bg >> 8);
            LCD_Write_Data(bg & 0xFF);
        }
    }
}

}

void LCD_Draw_String(uint8_t x, uint8_t y, char *str, FONT font, uint16_t color, uint16_t bg){
	//Chung nao chua viet xong chuoi
	while(*str){
		LCD_draw_char(x, y, *str, font, color, bg);
		//Tiep tuc viet
		x += font.width;
    str++;
  }
}
//------------------------------------------END OF LCD FUNC-------------------------------------------//